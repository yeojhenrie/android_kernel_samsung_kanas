## drivers/staging/android/Kconfig
```kconfig
menu "Android"

config ANDROID
	bool "Android Drivers"
	default N
	---help---
	  Enable support for various drivers needed on the Android platform

if ANDROID

config ASHMEM
	bool "Enable the Anonymous Shared Memory Subsystem"
	default n
	depends on SHMEM
	---help---
	  The ashmem subsystem is a new shared memory allocator, similar to
	  POSIX SHM but with different behavior and sporting a simpler
	  file-based API.

	  It is, in theory, a good memory allocator for low-memory devices,
	  because it can discard shared memory units when under memory pressure.

config ANDROID_LOGGER
	tristate "Android log driver"
	default n
	---help---
	  This adds support for system-wide logging using four log buffers.

	  These are:

	      1: main
	      2: events
	      3: radio
	      4: system

	  Log reading and writing is performed via normal Linux reads and
	  optimized writes. This optimization avoids logging having too
	  much overhead in the system.

config ANDROID_TIMED_OUTPUT
	bool "Timed output class driver"
	default y

config ANDROID_TIMED_GPIO
	tristate "Android timed gpio driver"
	depends on GPIOLIB && ANDROID_TIMED_OUTPUT
	default n

config ANDROID_LOW_MEMORY_KILLER
	bool "Android Low Memory Killer"
	default N
	---help---
	  Registers processes to be killed when memory is low

config ANDROID_LOW_MEMORY_KILLER_AUTODETECT_OOM_ADJ_VALUES
	bool "Android Low Memory Killer: detect oom_adj values"
	depends on ANDROID_LOW_MEMORY_KILLER
	default y
	---help---
	  Detect oom_adj values written to
	  /sys/module/lowmemorykiller/parameters/adj and convert them
	  to oom_score_adj values.

	  Enable this if lmkd sets the adj values from -17 to 16 instead of
	  the -1000 to 1000 scores. This tells LMK that the values has to be
	  converted regardless. This should also allow setting using the
	  oom_score_adj.

	  However setting values from -17 to 16 would cause some inaccuracies.

	  Say Y for Android 4 and below.

	  It's still safe to say Y otherwise. Even if the system lmkd
	  does use oom_score_adj right of the bat, it's highly unlikely
	  that it will use the values from -17 to 16.

config ANDROID_INTF_ALARM_DEV
	bool "Android alarm driver"
	depends on RTC_CLASS
	default n
	---help---
	  Provides non-wakeup and rtc backed wakeup alarms based on rtc or
	  elapsed realtime, and a non-wakeup alarm on the monotonic clock.
	  Also exports the alarm interface to user-space.

config SEC_OOM_KILLER
	bool "Android OOM Killer"
	default n
	help
	  klaatu@samsung
	  This enables 'Android-Style oom-killer'
	  The way to select victim by oom-killer provided by
	  linux kernel is totally different from android policy.
	  Hence, it makes more sense that we select the oom victim
	  as android does when LMK is invoked.

config SEC_DEBUG_LMK_MEMINFO
	bool "Show Meminfo when lmk invoked"
	default n
	help
	  Show memory information when lmk kills process

config SEC_DEBUG_LMK_COUNT_INFO
	bool "Record LMK execution count"
	default n
	help
	  Show LMK execution count information when lmk invoked

config SYNC
	bool "Synchronization framework"
	default n
	select ANON_INODES
	help
	  This option enables the framework for synchronization between multiple
	  drivers.  Sync implementations can take advantage of hardware
	  synchronization built into devices like GPUs.

config SW_SYNC
	bool "Software synchronization objects"
	default n
	depends on SYNC
	help
	  A sync object driver that uses a 32bit counter to coordinate
	  syncrhronization.  Useful when there is no hardware primitive backing
	  the synchronization.

config SW_SYNC_USER
	bool "Userspace API for SW_SYNC"
	default n
	depends on SW_SYNC
	help
	  Provides a user space API to the sw sync object.
	  *WARNING* improper use of this can result in deadlocking kernel
	  drivers from userspace.

config RUNTIME_COMPCACHE
	bool "Android rtcc v3"
	depends on ZRAM && ANDROID
	default n
	help
	  This option enables rtcc v3 for android

config KSWAPD_NOSWAP
	bool "Disable swap in kswapd"
	depends on RUNTIME_COMPCACHE
	default n
	help
	  This option controls swap action in kswapd

source "drivers/staging/android/fiq_debugger/Kconfig"

endif # if ANDROID

endmenu
```

## fs/sdcardfs.kitkat/Kconfig
```kconfig
config SDCARD_FS_KK
	bool "sdcard file system for android kitkat"
	depends on !SDCARD_FS
	default y
	help
	  Sdcardfs is based on Wrapfs file system.
	  This version is for kitkat based samsung phones as
	  the newer mainline sdcardfs is created for android versions
	  6.0 and above and thus is not compatible.

	  Choose this when in doubt.

if SDCARD_FS_KK
config SDCARD_FS_KK_FADV_NOACTIVE
	bool "sdcardfs fadvise noactive support"
	depends on FADV_NOACTIVE
	default y
	help
	  Sdcardfs supports fadvise noactive mode.

config SDCARD_FS_KK_CI_SEARCH
	bool "sdcardfs case-insensitive search support"
	depends on SDCARD_FS_KK
	default y

endif
```
