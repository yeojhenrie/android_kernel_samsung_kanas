## arch/arm/hotplug/Kconfig
```kconfig
menu "Generic ARM Soc Hotplug drivers"

# Alucard hotplug
source "arch/arm/hotplug/alucard/Kconfig"

# AutoSMP hotplug
source "arch/arm/hotplug/autosmp/Kconfig"

# Intelli_plug
source "arch/arm/hotplug/intelli_plug/Kconfig"

endmenu
```

## arch/arm/mach-sc/Kconfig
```kconfig
if ARCH_SC

menu "Spreadtrum SoC Type"

config  ARCH_SC8825
	bool "sc8825 series(tiger)"
	select CPU_V7
	select HAVE_SMP
	select ARM_GIC
	select HAVE_SCHED_CLOCK
	select LOCAL_TIMERS if SMP
	select VFP
	select VFPv3
	select NEON
	select GENERIC_TIME
	select CLKSRC_MMIO
	select ARCH_HAS_CPUFREQ
	select NEED_MACH_IO_H

config  ARCH_SCX35
	bool "sc8830 series(shark)"
	select CPU_V7
	select HAVE_SMP
	select ARM_GIC
	select HAVE_SCHED_CLOCK
	select LOCAL_TIMERS if SMP
	select VFP
	select VFPv3
	select NEON
	select GENERIC_TIME
	select CLKSRC_MMIO
	select ARCH_HAS_CPUFREQ
	select NEED_MACH_IO_H
	select ARM_HAS_SG_CHAIN

config ARCH_SCX15
	bool "scx15 series(dolphin,depend on ARCH_SCX35)"
	select ARCH_SCX35
	help
	  Support for Spreadtrum scx15(dolphin) based systems.

endmenu


menu "Spreadtrum Adie Type"

config ADIE_SC2713
        bool "Spredtrum A-die SC2713 Chip Support"
        default n
	help
	  Say Y here to support for Spreadtrum a-die sc2713 chip.

config ADIE_SC2713S
        bool "Spredtrum A-die SC2713S Chip Support"
        default n
	help
	  Say Y here to support for Spreadtrum a-die sc2713s chip.

config ADIE_SC2711
	bool "Spredtrum A-die SC2711 Chip Support"
        default n
	help
	  Say Y here to support for Spreadtrum a-die sc2711 chip.
endmenu


config SC_FPGA
       bool
       default n

menu "Spreadtrum Board Type"

config MACH_SP8825EA
	bool "sp8825ea Phone Board"
	depends on ARCH_SC
	depends on ARCH_SC8825
	default y
	help
	  sp8825 EB board based on SC8825 serial.

config MACH_SP5735EA
	bool "sp5735ea PAD Board"
	depends on ARCH_SC
	depends on ARCH_SCX35
	default n
	help
	  SP5735ea board based on SC8830 serial.

config MACH_SP5735C1EA
	bool "sp5735c1ea PAD Board"
	depends on ARCH_SC
	depends on ARCH_SCX35
	default n
	help
	  SP5735c1ea board based on SC8830 serial.

config MACH_SPX35EB
	bool "sp8830eb Phone Board"
	depends on ARCH_SC
	depends on ARCH_SCX35
	default n
	help
	  SPX35EB board based on SC8830 serial.

config MACH_SP8835EB
	bool "sp8835eb Phone Board"
	depends on ARCH_SC
	depends on ARCH_SCX35
	default n
	help
	  SP8835EB board based on SC8830 serial.

config MACH_SPX35EA
	bool "sp8830ea Phone Board"
	depends on ARCH_SC
	depends on ARCH_SCX35
	default n
	help
	  SPX35EA board based on SC8830 serial.

config MACH_SPX35EC
	bool "sp8830ec Phone Board"
	depends on ARCH_SC
	depends on ARCH_SCX35
	default n
	help
	  SPX35EC board based on SC8830 serial.

config MACH_KANAS_W
	bool "kanas W Phone Board"
	depends on ARCH_SC
	depends on ARCH_SCX35
	default n
	help
	  Samsung Kanas W board based on SC8830 serial.

config MACH_HUSKYTD
	bool "huskytd(sp8830ec) Phone Board"
	depends on ARCH_SC
	depends on ARCH_SCX35
	default n
	help
	  HUSKYTD(SPX35EC) board based on SC8830 serial.


config MACH_SP8830SSW
	bool "sp8830ssw Phone Board"
	depends on ARCH_SC
	depends on ARCH_SCX35
	default n
	help
	  Samsung SP8830SSW board based on SC8830 serial.

config MACH_TEDDY3G
	bool "Samsung Teddy Phone Board"
	depends on ARCH_SC
	depends on ARCH_SCX35
	default n
	help
	  Samsung Teddy board based on SC8830 serial.

config MACH_KANAS_TD
	bool "Kanas TD Phone Board"
	depends on ARCH_SC
	depends on ARCH_SCX35
	default n
	help
	  Samsung Kanass TD board based on SC8830 serial.


config MACH_SC9620OPENPHONE
	bool "sc9620openphone Board"
	depends on ARCH_SC
	depends on ARCH_SCX35
	default n
	help
	  ssc9620openphone board based on SC8830 serial.

config MACH_SC9620FPGA
        bool "sc9620fpga Board"
        depends on ARCH_SC
        depends on ARCH_SCX35
        default n
        help
          ssc9620fpga board based on SC8830 serial.

config MACH_SP7730EC
	bool "sp7730ec Phone Board"
	depends on ARCH_SC
	depends on ARCH_SCX35
	default n
	help
	  SP7730EC board based on SC8830 serial.

config MACH_SP7730ECTRISIM
	bool "sp7730ectrisim Phone Board"
	depends on ARCH_SC
	depends on ARCH_SCX35
	default n
	help
	  SP7730ECTRISIM board based on SC8830 serial.

config MACH_SPX35FPGA
	bool "sp8830 FPGA Board"
	depends on ARCH_SC
	depends on ARCH_SCX35
        select  SC_FPGA
	default n
	help
	  SPX35 fpga board based on SC8830 serial.

config MACH_SP7735EC
	bool "sp7735ec Phone Board"
	depends on ARCH_SC
	depends on ARCH_SCX35
	default n
	help
	  SP7735EC board based on SC8830 serial.


config MACH_SPX15FPGA
	bool "spx15 FPGA Board"
	depends on ARCH_SC
	depends on ARCH_SCX35
	depends on ARCH_SCX15
	default y
        select  SC_FPGA
	help
	  SPX15 fpga board based on dolphin serial.

config MACH_SP6815GA
	bool "sp6815ga Phone Board"
	depends on ARCH_SC
	depends on ARCH_SCX35
	depends on ARCH_SCX15
	default n
	help
	  SP6815GA board based on dolphin serial.
config MACH_SP7715EA
	bool "sp7715ea Phone Board"
	depends on ARCH_SC
	depends on ARCH_SCX35
	depends on ARCH_SCX15
	default n
	help
	  SP7715EA board based on dolphin serial.

config MACH_SP7715EATRISIM
	bool "sp7715eatrisim Phone Board"
	depends on ARCH_SC
	depends on ARCH_SCX35
	depends on ARCH_SCX15
	default n
	help
	SP7715EATRISIM board based on dolphin serial.

config MACH_SP7715EAOPENPHONE
	bool "sp7715eaopenphone Phone Board"
	depends on ARCH_SC
	depends on ARCH_SCX35
	depends on ARCH_SCX15
	default n
	help
	  SP7715EAOPENPHONE board based on dolphin serial.

config MACH_SP7715GA
	bool "sp7715ga Phone Board"
	depends on ARCH_SC
	depends on ARCH_SCX35
	depends on ARCH_SCX15
	default n
	help
	  SP7715GA board based on dolphin serial.

config MACH_SP7715GATRISIM
	bool "sp7715gatrisim Phone Board"
	depends on ARCH_SC
	depends on ARCH_SCX35
	depends on ARCH_SCX15
	default n
	help
	SP7715GATRISIM board based on dolphin serial.

config MACH_SP8815GA
	bool "sp8815ga Phone Board"
	depends on ARCH_SC
	depends on ARCH_SCX35
	depends on ARCH_SCX15
	default n
	help
	  SP8815GA board based on dolphin serial.

config MACH_SP8815GAOPENPHONE
	bool "sp8815gaopenphone Phone Board"
	depends on ARCH_SC
	depends on ARCH_SCX35
	depends on ARCH_SCX15
	default n
	help
	  SP8815GAOPENPHONE board based on dolphin serial.

config MACH_POCKET2
	bool "pocket2 Phone Board"
	depends on ARCH_SC
	depends on ARCH_SCX35
	depends on ARCH_SCX15
	default n
	help
	  POCKET2 board based on dolphin serial.

config MACH_CORSICA_VE
	bool "corsica_ve Phone Board"
	depends on ARCH_SC
	depends on ARCH_SCX35
	depends on ARCH_SCX15
	default n
	help
	  CORSICA_VE board based on dolphin serial.

config MACH_VIVALTO
	bool "vivalto Phone Board"
	depends on ARCH_SC
	depends on ARCH_SCX35
	depends on ARCH_SCX15
	default n
	help
	  VIVALTO board based on dolphin serial.

config MACH_YOUNG2
	bool "young2 Phone Board"
	depends on ARCH_SC
	depends on ARCH_SCX35
	depends on ARCH_SCX15
	default n
	help
	  YOUNG2 board based on dolphin serial.

config MACH_HIGGS
        bool "higgs Phone Board"
        depends on ARCH_SC
        depends on ARCH_SCX35
        depends on ARCH_SCX15
        default n
        help
          HIGGS board based on dolphin serial.

config MACH_SP8830GA
	bool "sp8830ga Phone Board"
	depends on ARCH_SC
	depends on ARCH_SCX35
	default n
	help
	  SP8830GA board based on SC8830 serial.

config MACH_SP7730GA
	bool "sp7730ga Phone Board"
	depends on ARCH_SC
	depends on ARCH_SCX35
	default n
	help
	  SP7730GA board based on SC8830 serial.

endmenu

config SPRD_ION_MM_SIZE
        int "size for ion"
        range 1 64
        default 1
	depends on ION

config SPRD_ION_OVERLAY_SIZE
        int "size for ion overlay"
        range 1 64
        default 1
	depends on ION

config SC_VIBRATOR
        bool "vibrator for SC serials"
        select ANDROID_TIMED_OUTPUT
        default n

config SC_VIBRATOR_GPIO
        bool "vibrator for SC serials by gpio"
        default n
	depends on SC_VIBRATOR

config SC_VIBRATOR_POWER
        bool "vibrator for SC serials by power"
        default n
       depends on SC_VIBRATOR

config EIRQ_NUM
        int "number for external irq region desc request"
        range 0 1024
	default 0

comment "SC8830 ADIE type"

config SC_INTERNAL_ADI
	bool "spreadtrum sc internal adi"
	default y
	depends on ARCH_SCX35

config SC_INTERNAL_ADC
	bool "spreadtrum sc internal adc"
	default y
	depends on ARCH_SCX35

config SC_INTERNAL_WATCHDOG
	bool "spreadtrum sc internal watchdog"
	default y
	depends on ARCH_SCX35

config FIX_V7TAGRAM_BUG
        bool "fix arm-v7 scu tag ram bug"
        default n
	depends on ARCH_SCX35
	depends on SMP

config DDR_VALIDITY_TEST
	bool "test ddr validity before go into ddr"
	default n

config SPRD_CPU_DYNAMIC_HOTPLUG
	bool "cpu dynamic hotplug with DVFS"
	default n
	depends on HOTPLUG_CPU
	depends on ARCH_SCX35

config SPRD_MEM_POOL
	default y
	bool "Using a memory pool to alloc 8k to 64k"
	depends on !COMPACTION
	help
	  This option enables memmory pool for allocating 8k to 64k.

config SPRD_DCDC_DEBUG
	tristate "Enable dcdc debug module"
	default n
	help
	  This option select dcdc debug module.

config SPRD_AVS_DEBUG
	tristate "Enable avs debug module"
	default n
	help
	  This option select avs debug module.

config SPRD_AUX_DEBUG
       tristate "Enable aux debug moduel"
       default y
       help
         This option select aux debug module.

config SPRD_SIMCTRL
	bool "Enable simctrl module"
	default n
	help
	  This option select simctrl module.
config SPRD_MODEM_TD
	bool "SPRD TD modem"
	default n
	help
	  This option select modem type.

config MODEM_W_MEMCUT
	bool "SPRD w modem memory cut"
	default n
	help
	  This option select for w modem memory cut.

config SIPC_TD
	bool "SIPC instance of TD modem"
	select SIPC
	default n

config SIPC_WCDMA
	bool "SIPC instance of WCDMA modem"
	select SIPC
	default n

config SIPC_WCN
	bool "SIPC instance of Wireless Connection"
	select SIPC
	default n

config VOIP_CPT
	bool "VOIP process in modem T,it is processed in modem W by default"
	default n
	depends on SIPC_TD

config CP_SWITCH
	bool "cp switch"
	default n
	help
	  This option select cp switch

config BUS_MONITOR
        bool "scxx35 AHB and DMC bus monitors"
        default n
	depends on ARCH_SCX35

config BUS_MONITOR_DEBUG
        bool "debug scxx35 AHB and DMC bus monitors"
        default n
	depends on BUS_MONITOR

config MACH_SHARK
	bool "For Shark Rev0.2 Hardware"
	default n
	
config EAR_LOW_LEVEL_DETECT
        bool "ear detecting trigger is low level"
        default n
config SS_FUNCTION
        bool "only for samsung function"
        default n
config TSP_0_1_A
        bool "For corsica_ve 3131 0.1A board"
        default n
		
config CONFIG_CPU_FREQ
		bool "cpu frequency"
		default y
config SEC_THERMISTOR
		bool "Sec thermister for SIOP implementation"
		default y
		
config MACH_KANAS
		bool " Kanas related changes "
		default n

menuconfig SC8830_CUSTOM_FREQ
	bool "Customize SC8830 processor frequency table (EXPERIMENTAL)"
	depends on CPU_FREQ 
	default n
    help
	 Does what it says. You may chose a higher or lower frequency for
	 this device. There are no guarantees that the device will be stable,
	 bootable, usable or cool after altering the frequency table.
	 (UC) means underclock; (OC) means overclock
	 (UV) means undervolt (<1 Volt); (OV) means overvolt (>1.3 Volt)
	 ----NOTE----
	 There should be an option to undervolt a frequency to a
	 supposedly 'safe' voltage. Again, there are no guarantees but
	 still hoping these options would be useful.

if SC8830_CUSTOM_FREQ
config SC8830_CUSTOM_1400000
	bool "1400 MHz (OC) (OV)"
	default n

config SC8830_CUSTOM_1400000_UV
	bool "Use at lower voltage"
	depends on SC8830_CUSTOM_1400000
	default n

config SC8830_CUSTOM_1300000
	bool "1300 MHz (OC) (OV)"
	default n

config SC8830_CUSTOM_1300000_UV
	bool "Use at lower voltage"
	depends on SC8830_CUSTOM_1300000
	default n

config SC8830_CUSTOM_1200000
	bool "1200 MHz"
	default y

config SC8830_CUSTOM_1200000_UV
	bool "Use at lower voltage"
	depends on SC8830_CUSTOM_1200000
	default n

config SC8830_CUSTOM_1100000
	bool "1100 MHz"
	default n

config SC8830_CUSTOM_1100000_UV
	bool "Use at lower voltage"
	depends on SC8830_CUSTOM_1100000
	default n

config SC8830_CUSTOM_1000000
	bool "1000 MHz"
	default y

config SC8830_CUSTOM_1000000_UV
	bool "Use at lower voltage"
	depends on SC8830_CUSTOM_1000000
	default n

config SC8830_CUSTOM_900000
	bool "900 MHz"
	default n

config SC8830_CUSTOM_900000_UV
	bool "Use at lower voltage"
	depends on SC8830_CUSTOM_900000
	default n

config SC8830_CUSTOM_800000
	bool "800 MHz"
	default n

config SC8830_CUSTOM_800000_UV
	bool "Use at lower voltage"
	depends on SC8830_CUSTOM_800000
	default n

config SC8830_CUSTOM_768000
	bool "768 MHz"
	default y

config SC8830_CUSTOM_768000_UV
	bool "Use at lower voltage"
	depends on SC8830_CUSTOM_768000
	default n

config SC8830_CUSTOM_700000
	bool "700 MHz"
	default n

config SC8830_CUSTOM_700000_UV
	bool "Use at lower voltage"
	depends on SC8830_CUSTOM_700000
	default n

config SC8830_CUSTOM_600000
	bool "600 MHz"
	default y

config SC8830_CUSTOM_600000_UV
	bool "Use at lower voltage"
	depends on SC8830_CUSTOM_600000
	default n

config SC8830_CUSTOM_500000
	bool "500 MHz (UC)"
	default n

config SC8830_CUSTOM_500000_UV
	bool "Use at lower voltage"
	depends on SC8830_CUSTOM_500000
	default n

config SC8830_CUSTOM_400000
	bool "400 MHz (UC)"
	default n

config SC8830_CUSTOM_400000_UV
	bool "Use at lower voltage"
	depends on SC8830_CUSTOM_400000
	default n

config SC8830_CUSTOM_300000
	bool "300 MHz (UC)"
	default n

config SC8830_CUSTOM_3800000_UV
	bool "Use at lower voltage"
	depends on SC8830_CUSTOM_300000
	default n

config SC8830_CUSTOM_200000
	bool "200 MHz (UC) (UV)"
	default n

config SC8830_CUSTOM_200000_UV
	bool "Use at lower voltage"
	depends on SC8830_CUSTOM_200000
	default n

config SC8830_CUSTOM_100000
	bool "100 MHz (UC) (UV)"
	default n
endif

config KANAS_GPS_AVDD18
       bool " Kanas related regulator setting"
       default n

config SEC_LOG
	bool "Samsung log buffer"
	default n
		
config WLAN_SDIO
    bool "WIFI SDIO"
    default y
    depends on WLAN

config SAMSUNG_PRODUCT_SHIP
	bool "set up for product shipping"
	default n

config FORCE_FAST_CHARGE
	bool "Force AC charge mode at will"
	default n
	help
	  A simple sysfs interface to force adapters that are
	  detected as USB to charge as AC.

endif
```
